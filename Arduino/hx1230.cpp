#include <Arduino.h>

#if (defined(__AVR__))
#include <avr\pgmspace.h>
#else
#include <pgmspace.h>
#endif

#include <hx1230.h>
//
// HX1230 LCD Library
// Copyright (c) 2018 BitBank Software, Inc.
// Written by Larry Bank
// Project started 4/30/2018
//
// The HX1230 is an inexpensive 96x68 monochrome LCD ($1.82 for mine). It's touted as a better
// replacement for the Nokia 5110 that are so popular in hobby projects. On this point, it's
// true. The only downside to this particular board is that it only exposes a 3-wire SPI
// interface. The controller is capable of I2C, SPI 4 and 3-wire. 3-wire means that the D/C
// signal is now the 9th bit added to each data byte. This prevents it from working with the
// hardware SPI interface, so it must be bit-banged. The CE/CS line can be tied to ground to
// save a GPIO pin, but the RESET line must be toggled upon power up to start using the display
// 
// This program is free software: you can redistribute it and/or modify
// it under the terms of the GNU General Public License as published by
// the Free Software Foundation, either version 3 of the License, or
// (at your option) any later version.
//
// This program is distributed in the hope that it will be useful,
// but WITHOUT ANY WARRANTY; without even the implied warranty of
// MERCHANTABILITY or FITNESS FOR A PARTICULAR PURPOSE.  See the
// GNU General Public License for more details.
//
// You should have received a copy of the GNU General Public License
// along with this program.  If not, see <http://www.gnu.org/licenses/>.
//

// small font
const byte ucFont[]PROGMEM = {0x00,0x00,0x00,0x00,0x00,0x00,0x00,0x00,0x7e,0x81,0x95,0xb1,0xb1,0x95,0x81,0x7e,
  0x7e,0xff,0xeb,0xcf,0xcf,0xeb,0xff,0x7e,0x0e,0x1f,0x3f,0x7e,0x3f,0x1f,0x0e,0x00,
  0x08,0x1c,0x3e,0x7f,0x3e,0x1c,0x08,0x00,0x38,0x9a,0x9f,0xff,0x9f,0x9a,0x38,0x00,
  0x10,0xb8,0xfc,0xfe,0xfc,0xb8,0x10,0x00,0x00,0x00,0x18,0x3c,0x3c,0x18,0x00,0x00,
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  0x02,0x03,0x01,0x03,0x02,0x03,0x01,0x00,0x70,0x78,0x4c,0x46,0x4c,0x78,0x70,0x00};

#ifndef __AVR_ATtiny85__
const byte ucBigFont[]PROGMEM = { 0x00,0x00,0x00,0x00,0x00,0x00,0x00,0x00,0x00,0x00,0x00,0x00,0x00,0x00,0x00,0x00,
  0x00,0x00,0x00,0x00,0x00,0x00,0x00,0x00,0x00,0x00,0x00,0x00,0x00,0x00,0x00,0x00,
  0x00,0x00,0x00,0x00,0x00,0x00,0x00,0x00,0x00,0x00,0x00,0x00,0x00,0x00,0x00,0x00,
  0x00,0x00,0x00,0x00,0x00,0x00,0x00,0x00,0x00,0x00,0x00,0x00,0x00,0x00,0x00,0x00,
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  0x00,0x00,0x00,0x00,0x00,0x00,0x00,0x00,0x00,0x00,0x00,0x00,0x00,0x00,0x00,0x00};
#endif // !ATtiny85
  // 5x7 font (in 6x8 cell)
const byte ucSmallFont[]PROGMEM = {0x00,0x00,0x00,0x00,0x00,0x00,0x00,0x3e,0x45,0x51,0x45,0x3e,0x00,0x3e,0x6b,0x6f,
  0x6b,0x3e,0x00,0x1c,0x3e,0x7c,0x3e,0x1c,0x00,0x18,0x3c,0x7e,0x3c,0x18,0x00,0x30,
  0x36,0x7f,0x36,0x30,0x00,0x18,0x5c,0x7e,0x5c,0x18,0x00,0x00,0x18,0x18,0x00,0x00,
  0x00,0xff,0xe7,0xe7,0xff,0xff,0x00,0x3c,0x24,0x24,0x3c,0x00,0x00,0xc3,0xdb,0xdb,
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  0x41,0x41,0x3e,0x08,0x00,0x02,0x01,0x02,0x01,0x00,0x00,0x3c,0x26,0x23,0x26,0x3c};

static int iScreenOffset; // current write offset of screen data
#ifdef BACKING_RAM
static unsigned char ucScreen[864]; // local copy of the image buffer
#endif
static byte iCSPin, iDataPin, iClockPin, iResetPin, iLEDPin;
static void hx1230WriteCommand(unsigned char c);

//
// SPI 3-wire transfers the D/C bit first, then 8-bits MSB first
// and latches the bits on the falling edge of the clock
// (idle low)
//
void bb_spi_transfer(byte *pBuf, byte bLen, byte bDC)
{
byte i, b, c;
   if (iCSPin != -1)
      digitalWrite(iCSPin, LOW);
   for (i=0; i<bLen; i++)
   {
      c = *pBuf++;
      // Write D/C bit
      digitalWrite(iDataPin, bDC); // set data bit (MSB first)
      digitalWrite(iClockPin, HIGH); // toggle clock
      digitalWrite(iClockPin, LOW); // high->low transition latches data
      
      for (b=0; b<8; b++)
      {
#ifdef __AVR_ATtiny85__
         if (c & 0x80)
            bitSet(PORTB, iDataPin); // faster to do direct bit manipulation on the ATtiny85
         else                       // than to call digitalWrite()
            bitClear(PORTB, iDataPin);
         bitSet(PORTB, iClockPin);
         bitClear(PORTB, iClockPin);
#else
         digitalWrite(iDataPin, (c & 0x80)); // set data bit (MSB first)
         digitalWrite(iClockPin, HIGH); // toggle clock
         digitalWrite(iClockPin, LOW); // high->low transition latches data
#endif
         c <<= 1; // shift over data
      } // for each bit
   } // for each byte
   if (iCSPin != -1)
      digitalWrite(iCSPin, HIGH);
} /* bb_spi_transfer() */

void hx1230PowerUp(void)
{
        hx1230WriteCommand(0x2f);
        hx1230WriteCommand(0x90);
        hx1230WriteCommand(0xa6);
        hx1230WriteCommand(0xa4);
        hx1230WriteCommand(0xaf);
        hx1230WriteCommand(0x40);
        hx1230WriteCommand(0xb0);
        hx1230WriteCommand(0x10);
        hx1230WriteCommand(0x00);
}
//
// Initializes the LCD controller into "horizontal write mode"
// Prepares the font data for the orientation of the display
// Parameters: GPIO pin numbers used for the DC/RST/LED control lines
//
void hx1230Init(int iReset, int iLED, int iCS, int iClock, int iData, byte bFlip180, byte bInvert)
{

   iCSPin = iCS;
   iClockPin = iClock;
   iDataPin = iData;
   iResetPin = iReset;
   iLEDPin = iLED;

   pinMode(iClockPin, OUTPUT);
   digitalWrite(iClockPin, LOW); // idle low
   pinMode(iDataPin, OUTPUT);
        pinMode(iResetPin, OUTPUT);
   if (iCSPin != -1) // -1 == not used
        pinMode(iCSPin, OUTPUT);
   if (iLEDPin != -1) // -1 == not used
        pinMode(iLEDPin, OUTPUT);

  // Start by reseting the LCD controller
   digitalWrite(iResetPin, HIGH);
   delay(50);
   digitalWrite(iResetPin, LOW);
   delay(5);
   digitalWrite(iResetPin, HIGH); // take it out of reset
   delay(10);
   hx1230Backlight(1); // turn on the backlight

   hx1230PowerUp(); // turn on and initialize the display

   if (bFlip180) // flip horizontal + vertical
   {
      hx1230WriteCommand(0xa1); // set SEG direction (A1 to flip horizontal)
      hx1230WriteCommand(0xc8); // set COM direction (C8 to flip vert)
   }
   if (bInvert)
   {
      hx1230WriteCommand(0xa7); // set inverted pixel mode
   }
   hx1230Fill(0); // erase memory
   hx1230SetContrast(0); // any other value seems to be too high

} /* hx1230Init() */

// Controls the LED backlight
void hx1230Backlight(int bOn)
{
  if (iLEDPin != -1)
  {
     digitalWrite(iLEDPin, (bOn) ? HIGH:LOW);
  }
} /* hx1230Backlight() */

//
// Sends a command to turn off the LCD display
//
void hx1230PowerDown()
{
    hx1230Fill(0); // fill memory with zeros to go to lowest power mode
    hx1230Backlight(0); // turn off the backlight
    hx1230WriteCommand(0xae); // power down
//    hx1230WriteCommand(0xa5); // all pixels on (saves power)
}

static void hx1230WriteCommand(unsigned char c)
{
   bb_spi_transfer(&c, 1, 0);
} /* hx1230WriteCommand() */

//
// 32 contrast levels (0-31)
//
int hx1230SetContrast(unsigned char ucContrast)
{
  if (ucContrast > 31) ucContrast = 31;
  hx1230WriteCommand(0x80 + ucContrast); // set contrast
  return 0;
} /* hx1230SetContrast() */

// Send commands to position the "cursor" to the given
// row and column
static void hx1230SetPosition(int x, int y)
{
  if (x > 95 || y > 8)
     return; // invalid
  hx1230WriteCommand(0xb0 | y); // set Y
  hx1230WriteCommand(0x10 | (x >> 4)); // set X MSB
  hx1230WriteCommand(0x00 | (x & 0xf)); // set X LSB
  iScreenOffset = (y*96)+x;
}

// Write a block of pixel data to the LCD
// Length can be anything from 1 to 504 (whole display)
static void hx1230WriteDataBlock(unsigned char *ucBuf, int iLen)
{
int i;

#ifdef BACKING_RAM
  if (iScreenOffset < 0 || iScreenOffset+iLen > sizeof(ucScreen))
     return; // invalid
   Keep a copy in local buffer
  memcpy(&ucScreen[iScreenOffset], ucBuf, iLen);
#endif
  iScreenOffset += iLen;
  while (iLen) // internal buffer is only 32 bytes
  {
     if (iLen >= 32)
        i = 32;
     else
        i = iLen;
     bb_spi_transfer(ucBuf, i, 1);
     ucBuf += i;
     iLen -= i;
  }
}

//
// Load a 96x68 1-bpp Windows bitmap
// Pass the pointer to the beginning of the BMP file
// First pass version assumes a full screen bitmap
//
int hx1230LoadBMP(byte *pBMP)
{
int16_t i16;
int iOffBits, q, y, j; // offset to bitmap data
int iPitch;
byte x, z, b, *s;
byte dst_mask;
byte ucTemp[32]; // process 32 bytes at a time
byte bFlipped = false;

  i16 = pgm_read_word(pBMP);
  if (i16 != 0x4d42) // must start with 'BM'
     return -1; // not a BMP file
  i16 = pgm_read_word(pBMP + 18);
  if (i16 != 96) // must be 128 pixels wide
     return -1;
  i16 = pgm_read_word(pBMP + 22);
  if (i16 != 68 && i16 != -68) // must be 68 pixels tall
     return -1;
  if (i16 == 68) // BMP is flipped vertically (typical)
     bFlipped = true;
  i16 = pgm_read_word(pBMP + 28);
  if (i16 != 1) // must be 1 bit per pixel
     return -1;
  iOffBits = pgm_read_word(pBMP + 10);
  iPitch = 12;
  if (bFlipped)
  {
    iPitch = -12;
    iOffBits += (67 * 12); // start from bottom
  }

// rotate the data and send it to the display
  for (y=0; y<9; y++) // 8 lines of 8 pixels and 1 line of 4 pixels
  {
     int n=8; // number of pixel rows per byte
     hx1230SetPosition(0, y);
     if (y == 8) n = 4; // last row only has 4 lines
     for (j=0; j<3; j++) // do 3 sections of 32 columns (96 pixels across)
     {
         s = &pBMP[iOffBits + (j*4) + (y * iPitch*8)]; // source line
         memset(ucTemp, 0, 32); // start with all black
         for (x=0; x<32; x+=8) // do each block of 32x8 pixels
         {
            dst_mask = 1;
            for (q=0; q<n; q++) // gather 8 (or 4) rows
            {
               b = pgm_read_byte(s + (q * iPitch));
               for (z=0; z<8; z++) // gather up the 8 bits of this column
               {
                  if (b & 0x80)
                      ucTemp[x+z] |= dst_mask;
                  b <<= 1; 
               } // for z
               dst_mask <<= 1;
            } // for q
            s++; // next source byte
         } // for x
         hx1230WriteDataBlock(ucTemp, 32);
     } // for j
  } // for y
} /* hx1230LoadBMP() */

// Set (or clear) an individual pixel
// The local copy of the frame buffer is used to avoid
// reading data from the display controller
int hx1230SetPixel(int x, int y, unsigned char ucColor)
{
int i;
unsigned char uc, ucOld;

  i = ((y >> 3) * 96) + x;
  if (i < 0 || i > 863) // off the screen
    return -1;
#ifdef BACKING_RAM
  uc = ucOld = ucScreen[i];
#else
  uc = 0; // no RAM, limited pixel access
#endif
  uc &= ~(0x1 << (y & 7));
  if (ucColor)
  {
    uc |= (0x1 << (y & 7));
  }
  if (uc != ucOld) // pixel changed
  {
    hx1230SetPosition(x, y>>3);
    hx1230WriteDataBlock(&uc, 1);
  }
  return 0;
} /* hx1230SetPixel() */

//
// Read the pixel at the given x,y
// if the library is not initialized, or the coordinates are
// not within the valid range, it returns 0
//
int hx1230GetPixel(int x, int y)
{
int i;

   i = ((y >> 3) * 96) + x;
   if (i < 0 || i > 863) // off the screen
#ifdef BACKING_RAM
   return (ucScreen[i] & (1<< (y & 7)));
#else
   return 0;
#endif
} /* hx1230GetPixel() */

// Draw a string of small (8x8) or large (16x24) characters
// At the given col+row
int hx1230WriteString(int x, int y, char *szMsg, int iSize, int bInverted)
{
int i, j, iLen;
unsigned char ucTemp[64];
const unsigned char *s;

    iLen = strlen(szMsg);
    
// big font won't fit on a ATtiny85
#ifndef __AVR_ATtiny85__
    if (iSize == FONT_LARGE) // draw 16x32 font
  {
    if (iLen*16 + x > 96) iLen = (96-x)/16;
    if (iLen < 0) return -1;
    for (i=0; i<iLen; i++)
    {
      s = &ucBigFont[(unsigned char)szMsg[i]*64];
      memcpy_P(ucTemp, s, 64);
      if (bInverted)
      {
         for (j=0; j<64; j++)
            ucTemp[j] = ~ucTemp[j];
      }
      hx1230SetPosition(x+(i*16), y);
      hx1230WriteDataBlock(ucTemp, 16);
      hx1230SetPosition(x+(i*16), y+1);
      hx1230WriteDataBlock(&ucTemp[16], 16);  
      hx1230SetPosition(x+(i*16), y+2);
      hx1230WriteDataBlock(&ucTemp[32], 16);  
      hx1230SetPosition(x+(i*16), y+3);
      hx1230WriteDataBlock(&ucTemp[48], 16);  
    }
  }
#endif // !ATtiny85

  if (iSize == FONT_NORMAL)// draw 8x8 font
   {
    hx1230SetPosition(x, y);
    if ((8*iLen) + x > 96) iLen = (96 - x)/8; // can't display it all
    if (iLen < 0)return -1;

    for (i=0; i<iLen; i++)
    {
      s = &ucFont[(unsigned char)szMsg[i] * 8];
      memcpy_P(ucTemp, s, 8); // copy from FLASH memory
      if (bInverted)
      {
         for (j=0; j<8; j++)
            ucTemp[j] = ~ucTemp[j];
      }
      hx1230WriteDataBlock(ucTemp, 8); // write character pattern
    } 
   }
   else if (iSize == FONT_SMALL) // 6x8
   {
    hx1230SetPosition(x, y);
    if ((6*iLen) + x > 96) iLen = (96 - x)/6; // can't display it all
    if (iLen < 0)return -1;

    for (i=0; i<iLen; i++)
    {
      s = &ucSmallFont[(unsigned char)szMsg[i] * 6];
      memcpy_P(ucTemp, s, 6); // copy from FLASH memory
      if (bInverted)
      {
         for (j=0; j<6; j++)
            ucTemp[j] = ~ucTemp[j];
      }
      hx1230WriteDataBlock(ucTemp, 6); // write character pattern
    } 

   }
  return 0;
} /* hx1230WriteString() */

// Fill the frame buffer with a byte pattern
// e.g. all off (0x00) or all on (0xff)
void hx1230Fill(byte ucData)
{
int x, y;
byte temp[32];

  memset(temp, ucData, 32);
  for (y=0; y<9; y++)
  {
    hx1230SetPosition(0,y); // set to (0,Y)
    for (x=0; x<3; x++)
    {
      hx1230WriteDataBlock(temp, 32); // fill with data byte
    } // for x
  } // for y;
} /* hx1230Fill() */

